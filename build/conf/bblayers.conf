## build/conf/bblayers.conf
```bitbake
# POKY_BBLAYERS_CONF_VERSION is increased each time build/conf/bblayers.conf
# changes incompatibly
POKY_BBLAYERS_CONF_VERSION = "2"

BBPATH = "${TOPDIR}"
BBFILES ?= ""

BBLAYERS ?= " \
  ${TOPDIR}/../layers/poky/meta \
  ${TOPDIR}/../layers/poky/meta-poky \
  ${TOPDIR}/../layers/poky/meta-yocto-bsp \
  ${TOPDIR}/../layers/bsp/meta-sunxi \
  ${TOPDIR}/../layers/third-party/meta-openembedded/meta-oe \
  ${TOPDIR}/../layers/third-party/meta-rauc \
  ${TOPDIR}/../layers/third-party/meta-rauc-community/meta-rauc-sunxi \
  ${TOPDIR}/../layers/third-party/meta-customer \
  "
```
